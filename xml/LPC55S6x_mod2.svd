# LPC55S6x register map
Vendor: nxp.com; File version: 1.0
CPU: CM33 r2p0, little endian, MPU, FPU, VTOR, 3 interrupt priority bits
Registers are 32-bit, read-write, reset 0x0 unless marked. A register's access mark holds for its fields unless they carry their own. Offsets are from the block's base; [hi:lo] are bit positions; lines under a group give offsets from that group; {n}, {i} and the like mark numbered series.

## GPIO — General Purpose I/O (GPIO)
Base 0x4008C000
Same registers: SECGPIO 0x400A8000
{0x0+0x20*i} B[{i}] (i=0..1) group
  {0x0+j} B_[{j}] (j=0..31) 8-bit — Byte pin registers for all port GPIO pins
    [0] PBYTE — Read: state of the pin PIOm_n, regardless of direction, masking, or alternate function, except that pins configured as analog I/O always read as 0. One register for each port pin. Supported pins depends on the specific device and package. Write: loads the pin's output bit. One register for each port pin. Supported pins depends on the specific device and package.
{0x1000+0x80*i} W[{i}] (i=0..1) group
  {0x0+4j} W_[{j}] (j=0..31) — Word pin registers for all port GPIO pins
    [31:0] PWORD — Read 0: pin PIOm_n is LOW. Write 0: clear output bit. Read 0xFFFF FFFF: pin PIOm_n is HIGH. Write any value 0x0000 0001 to 0xFFFF FFFF: set output bit. Only 0 or 0xFFFF FFFF can be read. Writing any value other than 0 will set the output bit. One register for each port pin. Supported pins depends on the specific device and package.
{0x2000+4i} DIR[{i}] (i=0..1) — Direction registers for all port GPIO pins
  [31:0] DIRP — Selects pin direction for pin PIOm_n (bit 0 = PIOn_0, bit 1 = PIOn_1, etc.). Supported pins depends on the specific device and package. 0 = input. 1 = output.
{0x2080+4i} MASK[{i}] (i=0..1) — Mask register for all port GPIO pins
  [31:0] MASKP — Controls which bits corresponding to PIOm_n are active in the MPORT register (bit 0 = PIOn_0, bit 1 = PIOn_1, etc.). Supported pins depends on the specific device and package.0 = Read MPORT: pin state; write MPORT: load output bit. 1 = Read MPORT: 0; write MPORT: output bit not affected.
{0x2100+4i} PIN[{i}] (i=0..1) — Port pin register for all port GPIO pins
  [31:0] PORT — Reads pin states or loads output bits (bit 0 = PIOn_0, bit 1 = PIOn_1, etc.). Supported pins depends on the specific device and package. 0 = Read: pin is low; write: clear output bit. 1 = Read: pin is high; write: set output bit.
{0x2180+4i} MPIN[{i}] (i=0..1) — Masked port register for all port GPIO pins
  [31:0] MPORTP — Masked port register (bit 0 = PIOn_0, bit 1 = PIOn_1, etc.). Supported pins depends on the specific device and package. 0 = Read: pin is LOW and/or the corresponding bit in the MASK register is 1; write: clear output bit if the corresponding bit in the MASK register is 0. 1 = Read: pin is HIGH and the corresponding bit in the MASK register is 0; write: set output bit if the corresponding bit in the MASK register is 0.
{0x2200+4i} SET[{i}] (i=0..1) — Write: Set register for port. Read: output bits for port
  [31:0] SETP — Read or set output bits (bit 0 = PIOn_0, bit 1 = PIOn_1, etc.). Supported pins depends on the specific device and package. 0 = Read: output bit: write: no operation. 1 = Read: output bit; write: set output bit.
{0x2280+4i} CLR[{i}] (i=0..1) wo reset not defined — Clear port for all port GPIO pins
  [31:0] CLRP — Clear output bits (bit 0 = PIOn_0, bit 1 = PIOn_1, etc.). Supported pins depends on the specific device and package. 0 = No operation. 1 = Clear output bit.
{0x2300+4i} NOT[{i}] (i=0..1) wo reset not defined — Toggle port for all port GPIO pins
  [31:0] NOTP — Toggle output bits (bit 0 = PIOn_0, bit 1 = PIOn_1, etc.). Supported pins depends on the specific device and package. 0 = no operation. 1 = Toggle output bit.
{0x2380+4i} DIRSET[{i}] (i=0..1) wo reset not defined — Set pin direction bits for port
  [31:0] DIRSETP — Set direction bits (bit 0 = PIOn_0, bit 1 = PIOn_1, etc.). Supported pins depends on the specific device and package. 0 = No operation. 1 = Set direction bit.
{0x2400+4i} DIRCLR[{i}] (i=0..1) wo reset not defined — Clear pin direction bits for port
  [31:0] DIRCLRP — Clear direction bits (bit 0 = PIOn_0, bit 1 = PIOn_1, etc.). Supported pins depends on the specific device and package. 0 = No operation. 1 = Clear direction bit.
{0x2480+4i} DIRNOT[{i}] (i=0..1) wo reset not defined — Toggle pin direction bits for port
  [31:0] DIRNOTP — Toggle direction bits (bit 0 = PIOn_0, bit 1 = PIOn_1, etc.). Supported pins depends on the specific device and package. 0 = no operation. 1 = Toggle direction bit.
